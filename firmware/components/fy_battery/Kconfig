## firmware/components/fy_battery/Kconfig
```kconfig
menu "Detector battery"

    config FY_BATTERY_FULL_MV
        int "Battery voltage shown as 100% (mV)"
        default 4270
        range 3500 4500
        help
            Measured battery voltage that maps to 100%. The default is what
            a Heltec V4.3 read under normal load just after a full charge was
            unplugged; it reads about 4300 mV while on the charger.

    config FY_BATTERY_EMPTY_MV
        int "Battery voltage shown as 0% (mV)"
        default 3200
        range 2800 3900
        help
            Measured battery voltage that maps to 0%. The default matches
            the protection cutoff, so the percentage is the share of runtime
            left before the board powers itself off.

    config FY_BATTERY_CUTOFF_MV
        int "Shut down below this battery voltage (mV)"
        default 3200
        range 2900 3700
        help
            Protects the cell from deep discharge. When the smoothed
            measured voltage stays below this for 30 s, the board shows a
            low-battery notice, saves open encounters, and powers off. The
            default sits past the knee of a typical single-cell Li-ion
            discharge curve and above 3.0 V even if the divider reads
            somewhat low.

    config FY_BATTERY_BOOT_MIN_MV
        int "Refuse to start below this battery voltage (mV)"
        default 3350
        range 3000 3900
        help
            Checked before anything else starts. Must be above the cutoff so
            a battery that recovers slightly at rest does not cycle the board
            on and off.

    config FY_BATTERY_RECHECK_S
        int "While off for low battery, re-check every (s)"
        default 600
        range 60 86400
        help
            A board shut down for low battery wakes briefly on this interval,
            measures without lighting the display, and starts normally once
            charging has raised the voltage above the start minimum.

endmenu
```

## firmware/components/fy_board/Kconfig
```kconfig
menu "Limier board"

    choice FY_BOARD
        prompt "Target board"
        default FY_BOARD_XIAO_ESP32S3
        help
            Selects the board profile: pins, indicators, and board power
            controls. Set by sdkconfig.defaults.<platformio env>.

        config FY_BOARD_XIAO_ESP32S3
            bool "Seeed Studio XIAO ESP32S3"

        config FY_BOARD_HELTEC_V43
            bool "Heltec WiFi LoRa 32 V4.3"

        config FY_BOARD_HELTEC_V4_R8
            bool "Heltec WiFi LoRa 32 V4 R8 (ESP32-S3R8)"
    endchoice

    config FY_BUZZER_GPIO
        int "Alert buzzer GPIO (-1: none)"
        default 3
        range -1 48
        help
            GPIO of a passive piezo buzzer for detection alerts, driven with
            a square wave. Upstream flock-you uses GPIO3 (the XIAO ESP32-S3's
            D2); it is free on both supported boards. -1 for no buzzer.

endmenu
```

## firmware/components/fy_dashboard/Kconfig
```kconfig
menu "Detector Wi-Fi dashboard"

    config FY_WIFI_DASHBOARD
        bool "Offer the Wi-Fi dashboard"
        default y if FY_BOARD_HELTEC_V43
        default n
        help
            A WPA3 access point serving the dashboard, started from the
            Device menu (or, on boards without a display, by five quick
            button presses). Detection is paused while it runs. The XIAO
            uses its USB dashboard instead.

    config FY_DASHBOARD_SSID_PREFIX
        string "Access point name prefix"
        default "FY-"
        help
            The access point is named this prefix followed by four random
            characters chosen on first use, for example FY-K7QM. Avoid names
            that announce what the device is.

    config FY_DASHBOARD_PASSKEY
        string "Shared access point passkey (empty: one per device)"
        default ""
        help
            Empty: each device generates its own temporary passkey on first
            use and shows it on its display. Boards without a display (the
            XIAO) use this shared passkey instead; it must be 8-63
            characters. Anyone who knows a shared passkey can join any
            device built with it while that device's dashboard is on.

    config FY_DASHBOARD_PASSWORD
        string "Default dashboard password"
        default "changeme"
        help
            Every device starts with this password for the USB and Wi-Fi
            dashboards (8-64 characters). The first login with it leads to
            a page that requires a new password before anything else opens;
            the new one is stored on the device as a salted PBKDF2 hash.

    config FY_DASHBOARD_CHANNEL
        int "Access point channel"
        default 6
        range 1 13

    config FY_DASHBOARD_IDLE_S
        int "End a dashboard session after this many seconds without use"
        default 600
        range 60 3600
        help
            A session ends when nobody has pressed the button or used the
            dashboard for this long. Detection then resumes in the selected
            mode. The page's own background checks do not count, so an
            open browser tab does not keep the session alive.

    config FY_DASHBOARD_CAPTIVE_PORTAL
        bool "Present the dashboards as a captive portal"
        default y
        help
            Phones open the dashboard in their "sign in to network"
            window, without turning off mobile data. The dashboard networks'
            DHCP servers also offer the device as gateway and DNS server, a
            DNS server answers every name with the device's address, and the
            HTTP server redirects everything except the dashboard there,
            including operating systems' connectivity checks, which do not
            count as dashboard activity. A PC on the USB link therefore also
            gets a default route and DNS server there (normally outranked by
            its other connections). Off: the networks offer an address only,
            and Android reaches the page only with mobile data and Wi-Fi off.

    config FY_DASHBOARD_HOST
        string "Dashboard host name"
        default "dash.fy"
        depends on FY_DASHBOARD_CAPTIVE_PORTAL
        help
            A name for the dashboard on a phone connected to the device:
            the portal's DNS answers it (like every name) with the device's
            address, and the server treats it as the device, so
            http://dash.fy/ opens the dashboard. Computers that ask their
            own DNS servers first may not resolve it; the address always
            works.

endmenu
```

## firmware/components/fy_detector/Kconfig
```kconfig
menu "Detector signatures"

    config FY_SIG_MOTOROLA
        bool "Match Motorola Solutions OUIs and BLE IDs"
        default y
        help
            Motorola Solutions' IEEE blocks and Bluetooth IDs cover its
            whole product line: two-way radios carried by retail, school,
            and venue staff as much as police. Matches are labeled
            possible. Turn off if they are noise where you use the device.

    config FY_SIG_SIERRA_WIRELESS
        bool "Match Sierra Wireless OUIs"
        default y
        help
            In-vehicle routers used by police fleets, and by many civilian
            fleets too. Matches are labeled possible.

    config FY_SIG_CRADLEPOINT
        bool "Match Cradlepoint OUIs"
        default n
        help
            Off by default, as in the parity reference: its field testing
            found no police vehicles and a steady stream of school buses
            and cellular traffic cameras.

    config FY_SIG_RADIO_OUIS_ANY_FRAME
        bool "Match Flock radio-module OUIs on any frame"
        default n
        help
            The community OUI list for Flock cameras is mostly Lite-On,
            Silicon Labs, Espressif, Samsung, and USI radio-module blocks,
            which also ship in laptops, phones, and IoT gear. Off: they are
            matched only in wildcard probe requests, where the IE
            fingerprint separates a camera from a laptop. On: upstream's
            behaviour, matching them as transmitter, receiver, or BSSID in
            any frame (labeled possible).

endmenu

menu "Detector output"

    config FY_SERIAL_JSON
        bool "Print upstream flock-you dashboard JSON for each reported match"
        default y
        help
            Each reported match is also printed on the console as one JSON
            line in the upstream flock-you format, which its Flask dashboard
            (api/flockyou.py) reads over USB serial. Lines carry no location;
            the dashboard adds the host's GPS. Log lines that are not JSON
            are ignored by the dashboard.

endmenu
```

## firmware/components/fy_gps/Kconfig
```kconfig
menu "Detector GPS"

    config FY_GPS_LOG_RAW_NMEA
        bool "Log every raw NMEA sentence"
        default n
        help
            Diagnostics only: echoes each sentence received from the GNSS
            receiver to the console, including sentences the parser ignores
            (satellites in view, receiver text such as antenna status). The
            output includes position data; leave this off in normal use.

endmenu
```

## firmware/components/fy_recorder/Kconfig
```kconfig
menu "Detector recording"

    config FY_ENCOUNTER_ABSENCE_S
        int "Seconds of silence that close an encounter"
        default 60
        range 5 3600
        help
            Repeated sightings of one device belong to the same encounter
            until it goes unseen for this long. To be validated for driving,
            walking, and stationary use.

    config FY_ENCOUNTER_CHECKPOINT_S
        int "Rewrite interval for a changing encounter (s)"
        default 60
        range 10 3600
        help
            An open encounter that has changed is rewritten at most this
            often, which bounds what an abrupt power cut can lose.

    config FY_BATTERY_LOG_INTERVAL_S
        int "Battery sample interval (s)"
        default 60
        range 10 3600
        help
            Interval between stored battery samples on boards that can
            measure a battery. Used to characterise charge and discharge.

    config FY_STORAGE_WARN_PERCENT
        int "Storage use that triggers an offload warning (%)"
        default 90
        range 50 99

endmenu
```

## firmware/components/fy_status_led/Kconfig
```kconfig
menu "Detector status LED"

    config FY_STATUS_LED_PATTERNS
        bool "Show the operating mode on the status LED"
        default y if FY_BOARD_XIAO_ESP32S3
        default n
        help
            Solid while booting, one short blink every 3 s while scanning,
            one every 10 s in standby, and a double blink every 3 s while
            the Wi-Fi dashboard is active. A specific match shows as a
            quick triple flash either way. On by default for boards without
            a display, where the LED is the only status indicator.

endmenu
```

## firmware/components/fy_usb/Kconfig
```kconfig
menu "Detector USB dashboard"

    config FY_USB_DASHBOARD
        bool "Offer the dashboard over USB networking, with a USB console"
        depends on TINYUSB_NET_MODE_NCM && TINYUSB_CDC_ENABLED
        default y
        help
            Lets the native USB port become a composite device: a CDC-ACM
            serial port that carries the console, and a CDC-NCM network
            interface at 192.168.7.1 serving the dashboard. Only offered
            when the TinyUSB NCM and CDC options are enabled, which both
            boards' sdkconfig defaults do.

    config FY_USB_DASHBOARD_AT_BOOT
        bool "Start the USB dashboard at boot"
        depends on FY_USB_DASHBOARD
        default y if FY_BOARD_XIAO_ESP32S3
        default n
        help
            On: the USB dashboard runs from boot (the XIAO's only
            dashboard). Off: it is started from the Device menu (the
            Heltec), and the port keeps the USB Serial/JTAG console until
            then.

endmenu
```
